## main/Kconfig.projbuild
```kconfig
menu "RotorREC serial bridge"

config BF_CAM_LCD
    bool
    default y if IDF_TARGET_ESP32C6
    default n

config BF_CAM_UART_ENABLED
    bool "Enable Betaflight MSP UART bridge"
    default y
    help
        Uses UART1, independent of USB logging. Never writes flight-control settings.

config BF_CAM_UART_TX_GPIO
    int "ESP32 UART TX GPIO (connect to FC RX)"
    range 0 23
    default 0 if IDF_TARGET_ESP32C3
    default 18

config BF_CAM_UART_RX_GPIO
    int "ESP32 UART RX GPIO (connect to FC TX)"
    range 0 23
    default 1 if IDF_TARGET_ESP32C3
    default 19

config BF_CAM_UART_BAUD
    int "MSP baud rate (must match FC port)"
    range 9600 460800
    default 115200

config BF_CAM_USER_MODE_ID
    int "Recording USER mode permanent ID (USER1=40 through USER4=43)"
    range 40 43
    default 40
    help
        Assign any AUX channel/range to this mode in Betaflight, not in ESP32 firmware.
        The mode must appear in MSP_BOXIDS. No fallback to ARM or a raw channel.

endmenu
```

## sdkconfig.defaults
```kconfig
CONFIG_IDF_TARGET="esp32c6"
CONFIG_ESPTOOLPY_FLASHSIZE_8MB=y
CONFIG_PARTITION_TABLE_CUSTOM=y
CONFIG_PARTITION_TABLE_CUSTOM_FILENAME="config/partitions-c6.csv"
CONFIG_BOOTLOADER_APP_ROLLBACK_ENABLE=y
CONFIG_ESP_TASK_WDT_INIT=y
CONFIG_ESP_TASK_WDT_PANIC=y
CONFIG_ESPTOOLPY_FLASHMODE_QIO=y
CONFIG_ESP_CONSOLE_USB_SERIAL_JTAG=y
CONFIG_ESP_CONSOLE_USB_SERIAL_JTAG_ENABLED=y
CONFIG_LV_FONT_MONTSERRAT_20=y
CONFIG_BT_ENABLED=y
CONFIG_BT_BLE_42_FEATURES_SUPPORTED=y
CONFIG_BT_BLE_50_FEATURES_SUPPORTED=n
CONFIG_BT_LE_50_FEATURE_SUPPORT=n
```
